## config/modules/custom_battery_typist/Kconfig
```kconfig
config CUSTOM_BATTERY_TYPIST
    bool "Enable battery level typing behavior"
    default y
    depends on ZMK_BATTERY_REPORTING
    depends on !ZMK_SPLIT || ZMK_SPLIT_ROLE_CENTRAL
```

## config/modules/custom_battery_typist/dts/bindings/zmk,behavior-battery-type.yaml
```yaml
description: Battery level typing behavior
compatible: "zmk,behavior-battery-type"
include: zero_param.yaml
```
